## conf/machine/srg-im8p.conf
```bitbake
#@TYPE: Machine
#@NAME: AAEON SRG-IM8P Gateway
#@SOC: i.MX8MP
#@DESCRIPTION: Machine configuration for AAEON SRG-IM8P Gateway
#@MAINTAINER: KunYi Chen <kunyi.chen@gmail.com>
#@SPDX-License-Identifier: MIT

MACHINEOVERRIDES =. "imx-boot-container:mx8:mx8m:mx8mp:"

require conf/machine/include/imx-base.inc
require conf/machine/include/tune-cortexa53.inc

MACHINE_FEATURES += "pci wifi bluetooth jailhouse optee tpm2"
MACHINE_FEATURES_remove += "usbgadget"

IMX_DEFAULT_BOOTLOADER ?= "u-boot-imx"
PREFERRED_VERSION_u-boot-imx_mx8mp ?= "2021.04"
PREFERRED_VERSION_virtual/bootloader_mx8mp ?= "2021.04"

UBOOT_SUFFIX = "bin"

UBOOT_CONFIG ??= "sd"
UBOOT_CONFIG[sd]      = "${UBOOT_CONFIG_BASENAME}_defconfig,sdcard"
UBOOT_CONFIG[ecc]     = "${UBOOT_CONFIG_BASENAME}_inline_ecc_defconfig"
UBOOT_CONFIG[mfgtool] = "${UBOOT_CONFIG_BASENAME}_defconfig"

SPL_BINARY = "spl/u-boot-spl.bin"

ATF_PLATFORM = "imx8mp"
ATF_LOAD_ADDR = "0x970000"

# Extra firmware package name, that is required to build boot container for fslc bsp
IMX_EXTRA_FIRMWARE = "firmware-imx-8m"

IMXBOOT_TARGETS = \
    "${@bb.utils.contains('UBOOT_CONFIG', 'fspi', '${IMXBOOT_TARGETS_BASENAME}_flexspi', \
                                                  '${IMXBOOT_TARGETS_BASENAME}', d)}"

IMX_BOOT_SOC_TARGET = "iMX8MP"

SERIAL_CONSOLES = "115200;ttymxc1"

LOADADDR = ""
UBOOT_SUFFIX = "bin"
UBOOT_MAKE_TARGET = "all"
IMX_BOOT_SEEK = "32"

OPTEE_BIN_EXT = "8mp"
TEE_LOAD_ADDR = "0x56000000"

# Add additional firmware


#KERNEL_IMAGETYPES_append += "fitImage"
#KERNEL_CLASSES += "kernel-fitimage"

KERNEL_LOADADDR_mx8mp = "0x40480000"

KERNEL_DEVICETREE_BASENAME = "${MACHINE}"

MACHINE_FEATURES += "pci optee jailhouse tpm2"
MACHINE_FIRMWARE_remove = " linux-firmware-ath10k"

UBOOT_CONFIG_BASENAME = "${MACHINE}"
UBOOT_CONFIG[fspi] = "${UBOOT_CONFIG_BASENAME}_defconfig"

# Set DDR FIRMWARE
DDR_FIRMWARE_VERSION = "202006"
DDR_FIRMWARE_NAME = " \
	lpddr4_pmu_train_1d_dmem_${DDR_FIRMWARE_VERSION}.bin \
	lpddr4_pmu_train_1d_imem_${DDR_FIRMWARE_VERSION}.bin \
	lpddr4_pmu_train_2d_dmem_${DDR_FIRMWARE_VERSION}.bin \
	lpddr4_pmu_train_2d_imem_${DDR_FIRMWARE_VERSION}.bin \
"

IMXBOOT_TARGETS_BASENAME = "flash_evk"

KERNEL_DEVICETREE = " \
    freescale/${KERNEL_DEVICETREE_BASENAME}.dtb \
"

UBOOT_DTB_NAME = "${KERNEL_DEVICETREE_BASENAME}.dtb"


# Add DTB of i.MX 8MP LPDDR4 EVK
KERNEL_DEVICETREE += " \
                     freescale/imx8mp-evk.dtb \
"


SOC_DEFAULT_WKS_FILE_mx8mp = "srg-im8p-image.wks.in"
```
